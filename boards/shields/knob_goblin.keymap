/*
 * Copyright (c) 2022 The ZMK Contributors
 *
 * SPDX-License-Identifier: MIT
 */

#include <behaviors.dtsi>
#include <dt-bindings/zmk/keys.h>
#include <dt-bindings/zmk/bt.h>
#include <dt-bindings/zmk/outputs.h>

#define PIN_MACRO(name, pin) \
/ { \
    macros { \
        name: name { \
            compatible = "zmk,behavior-macro"; \
            wait-ms = <5>; \
            tap-ms = <5>; \
            #binding-cells = <0>; \
            bindings = <&kp P &kp I &kp N &kp SPACE>, pin, <&kp ENTER>; \
        }; \
    }; \
};

PIN_MACRO(pin14, <&kp N1 &kp N4>)
PIN_MACRO(pin15, <&kp N1 &kp N5>)
PIN_MACRO(pin16, <&kp N1 &kp N6>)


/ {
    keymap {
        compatible = "zmk,keymap";

        default_layer {
            bindings = <&pin14
                        &mo1
                        &pin16>;
        };

        bt_layer { //layer 1
            bindings = <
                &bt BT_SEL 0    &bt BT_CLR_ALL    &out OUT_TOG
            >;
        };
    };
};